## Lua-5.2/Kconfig
```kconfig
#
# Lua Configuration
#

comment "Lua-5.2.4"

config LUA
	bool
	default y
	select LIBC_LOCALE

config LUA_COMPAT_ALL
	bool "Lua compatibility"
	default y
	---help---
		Enables compatibility with previous Lua versions.

config LUA_USE_POSIX
	bool "Posix compatibility"
	default y
	---help---
		Enables usage of Posix API by Lua.
		
		Note that only features that are supported by
		NuttX will be enabled.

config LUA_STDIO
	bool "Standard I/O"
	default y
	depends on LUA_IO_LIB
	---help---
		Enables access to stdio (stdin, stdout, stderr), by Lua.

config LUAI_MAXSTACK
	int "Lua stack size"
	default 5000
	---help---
		Limits the size of the Lua stack.
		Change it if you need a different limit. This limit is arbitrary;
		its only purpose is to stop Lua from consuming unlimited stack
		space (and to reserve some numbers for pseudo-indices).

config LUA_NUMBER_FMT
	string "Lua number format"
	default "%.14g"
	---help---
		Specifies the format for writing numbers.

menu "Libraries"

config LUA_BASE_LIB
	bool "Base lib"
	default y

config LUA_PACKAGE_LIB
	bool "Package lib"
	default y

config LUA_COROUTINE_LIB
	bool "Coroutine lib"
	default y

config LUA_TABLE_LIB
	bool "Table lib"
	default y

config LUA_IO_LIB
	bool "IO lib"
	default y

config LUA_SYSTEM_LIB
	bool "System lib"
	default y

config LUA_STRING_LIB
	bool "String lib"
	default y

config LUA_BIT_LIB
	bool "Bit lib"
	default y

config LUA_MATH_LIB
	bool "Math lib"
	default y

config LUA_DEBUG_LIB
	bool "Debug lib"
	default y

endmenu

config LUA_SANDBOX
	bool "Sandbox Lua"
	default n
	---help---
		If enabled, Lua is "sandboxed" by disabling various library
		calls that have system side-effects.
		
		Most notably, sandbox disables calls towards the OS, file
		system I/O, standard I/O (console), debug features and more.
		
		This is not a complete sandbox, the application must make
		sure that all Lua calls are protected, and of course that
		no external libraries allow access to the OS, bypassing
		the limitations imposed on the standard library.

config LUA_LTR
	bool "Lua Tiny RAM patch"
	default y
	---help---
		Enables the Lua Tiny RAM (LTR) patch.

config EXTERN_ROTABLE
	bool "External rotable for LTR"
	default n
	depends on LUA_LTR
	---help---
		If enabled, an external rotable will be used, instead of
		the default provided here.
		
		This is useful to allow extending the standard libraries,
		with other user-defined lirbaries.
		
		The rotable needs to be named `extern_rotable` and it must
		adhere to the specific structure that is seen in linit.c
		for the default table.
```

## ftp/Kconfig
```kconfig
#
# FTP Client Configuration
#

config FTPC_CONTROL_TIMEOUT
	int "Control socket timeout"
	default 10
	---help---
		The control socket timeout, in seconds.

config FTPC_DATA_TIMEOUT
	int "Data socket timeout"
	default 10
	---help---
		The data socket timeout, in seconds.

config FTPC_BUFFER_SIZE
	int "Buffer size"
	default 256
	---help---
		Internal buffer size.

config FTPC_SENDFILE
	bool "Use sendfile"
	default y
	depends on NET_SENDFILE
	---help---
		If enabled, sendfile() will be used for uploading files
		to the server.
		
		Sendfile is more optimized for the task and better performance
		is expected to be achieved.
		
		Note however that this may not be portable to other OS'es.
```

## geolocation/Kconfig
```kconfig
#
# Geolocation Service Configuration
#

comment "Geolocation configuration"

config GEOLOCATION
	bool "Geolocation"
	default y
	---help---
		Enables the Geolocation service.

if GEOLOCATION

config GEOLOCATION_API_KEY
	string "API Key"
	default ""
	---help---
		Geolocaiton provider API key.

config GEOLOCATION_BUFFER_SIZE
	int "Buffer size"
	default 512
	---help---
		The size of the internal buffer.

config GEOLOCATION_START_DELAY
	int "Start delay"
	default 10
	---help---
		Geolocation initial request delay.
		In seconds.

config GEOLOCATION_RETRY_INTERVAL
	int "Retry interval"
	default 10
	---help---
		In case of any error, the service will
		try to perform a new request after this
		time period. In seconds.

endif
```

## mqtt_broker/Kconfig
```kconfig
#
# MQTT Broker Configuration
#

menuconfig MQTT_BROKER
	bool "MQTT Broker"
	default y
	select NET_TCP_KEEPALIVE
	select NET_TCPBACKLOG
	select NET_LOOPBACK
	---help---
		If enabled, a simple and lightweight MQTT
		broker will be included in the build.

if MQTT_BROKER

comment "Broker configuration"

config MQTT_BROKER_PRIORITY
	int "MQTT broker priority"
	default 100
	---help---
		Priority of the broker task.

config MQTT_BROKER_STACKSIZE
	int "MQTT broker stack size"
	default 3072
	---help---
		Broker task stack size.

comment "Server configuration"

config MQTT_BROKER_PORT
	int "MQTT server port"
	default 1883
	---help---
		The port that the broker listens to.

config MQTT_BROKER_INACTIVE_TIMEOUT
	int "Inactivity timeout"
	default 5
	---help---
		Connection inactivity timeout.
		If a new connection is established but the
		client does not send a valid CONNECT message
		within this period, the connection will be dropped.
		
		In seconds.

comment "Sessions configuration"

config MQTT_BROKER_MAX_SESSIONS
	int "Maximum sessions"
	default 8
	---help---
		Maximum allowed active sessions.

config MQTT_BROKER_MAX_INFLIGHT
	int "Maximum in-flight messages"
	default 2
	---help---
		Maximum number of messages that can be
		in-flight for every session.

config MQTT_BROKER_MAX_SUBSCRIPTIONS
	int "Maximum subscriptions"
	default 8
	---help---
		Maximum allowed subscriptions per session.

config MQTT_BROKER_STORE_SESSIONS
	bool "Store closed sessions"
	default y
	---help---
		If enabled, any closed session will be stored.
		If the same client tries to connect at a later
		time, the session will be restored.

config MQTT_BROKER_MAX_STORED_SESSIONS
	int "Maximum stored sessions"
	default 4
	depends on MQTT_BROKER_STORE_SESSIONS
	---help---
		Maximum number of sessions that will be stored.

comment "Queues configuration"

config MQTT_BROKER_QUEUE_SIZE
	int "Queue size"
	default MQTT_BROKER_MAX_SESSIONS
	---help---
		Maximum number of messages in the publish queue.

config MQTT_BROKER_MAX_RETAINED
	int "Maximum retained messages"
	default MQTT_BROKER_MAX_SESSIONS
	---help---
		Maximum number of retained messages.

comment "Logger configuration"

choice
	prompt "Logger"
	default MQTT_BROKER_LOG_NONE

config MQTT_BROKER_LOG_SYSLOG
	bool "Syslog"
	---help---
		Broker log messages will be printed to
		syslog.

config MQTT_BROKER_LOG_FILE
	bool "File"
	---help---
		Broker log messages will be printed to
		a dedicated file.

config MQTT_BROKER_LOG_NONE
	bool "None"
	---help---
		Broker logging is disabled.
		All log messages will be discarded.

endchoice

config MQTT_BROKER_LOG_DEBUG
	bool "Log DEBUG level"
	default n
	depends on !MQTT_BROKER_LOG_NONE
	---help---
		Enables logging of DEBUG level messages.

config MQTT_BROKER_LOG_FILENAME
	string "Log filename"
	default "/mnt/sdcard0/mqtt_broker.log"
	depends on MQTT_BROKER_LOG_FILE
	---help---
		Filename and path of the broker's
		log file.

endif
```

## mqtt_client/Kconfig
```kconfig
#
# MQTT Configuration
#

menu "MQTT"

comment "MQTT Client"

choice
	prompt "MQTT Version"
	default MQTT_VER_3_1_1

config MQTT_VER_3_1
	bool "v3.1.0"
	
config MQTT_VER_3_1_1
	bool "v3.1.1"

endchoice

config MQTT_KEEPALIVE_INTERVAL
	int "Keep-alive interval"
	default	10
	---help---
		The keep-alive interval of the connection.
		In seconds. 

config MQTT_TIMEOUT
	int "Sockets timeout"
	default 5
	---help---
		Sockets timeout, in seconds.

config MQTT_RECONNECT_INTERVAL
	int "Re-connection interval"
	default 5
	---help---
		The time interval that a re-connection will
		be attempted. In seconds.

endmenu
```

## settings/Kconfig
```kconfig
#
# Settings Storage Configuration
#

config SETTINGS_MAP_SIZE
	int "Settings storage size"
	default 20
	---help---
		The size of the settings storage, i.e. the
		maximum number of settings that can be created.

config SETTINGS_KEY_SIZE
	int "Settings key size"
	default 20
	---help---
		Maximum size of a setting key.

config SETTINGS_VALUE_SIZE
	int "Settings value size"
	default 20
	---help---
		Maximum size of a string setting value.

config SETTINGS_MAX_STORAGES
	int "Settings files"
	default 2
	---help---
		Maximum number of supported settings files.

config SETTINGS_MAX_FILENAME
	int "Settings filename size"
	default 50
	---help---
		Maximum size of settings filename.

config SETTINGS_CACHED_SAVES
	bool "Cache save operations"
	default y
	---help---
		If enabled saving to the storages will be cached.
		
		Whenever a save is triggered, the settings will only
		be saved in the RAM map (and will be immediately
		effective). Writes to the storages though will
		happen after a small delay.
		
		This improves performance greatly when multiple
		successive saves are to be performed, as the actual
		write will happen only once, asynchronously.

config SETTINGS_MAX_SIGNALS
	int "Max. settings signals"
	default 2
	---help---
		Maximum number of signals that can be registered
		on the settings storage.
```
